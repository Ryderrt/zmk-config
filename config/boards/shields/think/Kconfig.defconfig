## config/boards/shields/think/Kconfig.defconfig
```kconfig
if SHIELD_THINK_LEFT

config ZMK_KEYBOARD_NAME
	default "think"

config ZMK_SPLIT_ROLE_CENTRAL
	default y

endif

if SHIELD_THINK_LEFT || SHIELD_THINK_RIGHT

config ZMK_SPLIT
	default y

endif
```

## config/boards/shields/think/Kconfig.shield
```kconfig
config SHIELD_THINK_LEFT
	def_bool $(shields_list_contains,think_left)

config SHIELD_THINK_RIGHT
	def_bool $(shields_list_contains,think_right)
```
